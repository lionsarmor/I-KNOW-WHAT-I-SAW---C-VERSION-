## platform/esp32/sdkconfig.defaults
```kconfig
# 1 kHz FreeRTOS tick so the 60 Hz frame pacing is accurate
CONFIG_FREERTOS_HZ=1000
# optimize for speed, not size -- we push a lot of pixels
CONFIG_COMPILER_OPTIMIZATION_PERF=y
```

## platform/esp32/sdkconfig.defaults.esp32c3
```kconfig
# ESP32-C3 (Super Mini) specifics -- applied on top of sdkconfig.defaults
# when the target is esp32c3.
#
# The Super Mini handheld wiring uses GPIO 20/21 (normally UART0 RX/TX)
# for I2S audio, so send logs over the board's native USB port instead.
CONFIG_ESP_CONSOLE_USB_SERIAL_JTAG=y
```
